// main.cpp
#include "main.h"

// Initialize display
Adafruit_SSD1306 display(SCREEN_WIDTH, SCREEN_HEIGHT, &Wire, OLED_RESET);

// Devil logo
const uint8_t DEVIL_LOGO[] PROGMEM = {
    0x00,0x00,0x00,0x00,0x00,0x00,0x00,0x00,0x00,0x00,0x00,0x00,0x00,0x00,0x00,0x00,
    0x00,0x00,0x00,0x00,0x00,0x00,0x00,0x00,0x00,0x00,0x00,0x00,0x00,0x00,0x00,0x00,
    0x00,0x00,0x00,0x00,0x00,0x00,0x00,0x00,0x00,0x00,0x00,0x00,0x00,0x00,0x00,0x00,
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    0x00,0x00,0x00,0x00,0x00,0x00,0x00,0x00,0x00,0x00,0x00,0x00,0x00,0x00,0x00,0x00
};

// Menu and state variables
const char* menu_items[] = {"Random (Slow)", "Random (Fast)", "Custom SSID", "About"};
int current_menu = 0;
volatile bool menu_active = true;
volatile bool spamming = false;
String custom_ssids[64]; // Array for 64 SSIDs from wlist.txt
int custom_ssid_count = 0;
const int num_ssids = 64; // Updated to 64 SSIDs for multi-SSID mode
String ssids[64]; // Array for 64 random SSIDs
TaskHandle_t displayTaskHandle = NULL;
TaskHandle_t wifiTaskHandle = NULL;

// Debounce variables
unsigned long lastDebounceTime = 0;
const unsigned long debounceDelay = 300;

void setup() {
    Serial.begin(115200);
    Wire.begin(SDA_PIN, SCL_PIN);
    if (!display.begin(SSD1306_SWITCHCAPVCC, 0x3C)) {
        Serial.println(F("SSD1306 allocation failed"));
        for(;;);
    }
    display.clearDisplay();
    display.display();

    pinMode(BTN_DOWN, INPUT);
    pinMode(BTN_UP, INPUT);
    pinMode(BTN_ENTER, INPUT);

    // Initialize SPIFFS
    if (!SPIFFS.begin(true)) {
        Serial.println(F("SPIFFS Mount Failed"));
        display.clearDisplay();
        display.setTextSize(1);
        display.setTextColor(SSD1306_WHITE);
        display.setCursor(10, 20);
        display.println(F("SPIFFS Mount Failed"));
        display.display();
        for(;;);
    }

    // Read SSID list from file
    if (!readSSIDList()) {
        Serial.println(F("Failed to read wlist.txt"));
        display.clearDisplay();
        display.setTextSize(1);
        display.setTextColor(SSD1306_WHITE);
        display.setCursor(10, 20);
        display.println(F("Failed to read wlist.txt"));
        display.display();
        vTaskDelay(3000 / portTICK_PERIOD_MS);
    }

    WiFi.mode(WIFI_AP);
    WiFi.softAPdisconnect(true);

    // Generate initial SSIDs for multi-SSID mode
    for (int i = 0; i < num_ssids; i++) {
        ssids[i] = generateRandomSSID();
    }

    // Start display task
    xTaskCreatePinnedToCore(
        displayTask, "DisplayTask", 4096, NULL, 1, &displayTaskHandle, 0);

    // Show logo animation
    displayLogoAnimation();
}

void loop() {
    if (menu_active) {
        if (digitalRead(BTN_DOWN) == HIGH && (millis() - lastDebounceTime) > debounceDelay) {
            current_menu = (current_menu + 1) % 4;
            lastDebounceTime = millis();
        }
        if (digitalRead(BTN_UP) == HIGH && (millis() - lastDebounceTime) > debounceDelay) {
            current_menu = (current_menu - 1 + 4) % 4;
            lastDebounceTime = millis();
        }
        if (digitalRead(BTN_ENTER) == HIGH && (millis() - lastDebounceTime) > debounceDelay) {
            menu_active = false;
            if (menu_items[current_menu] == "Random (Slow)") {
                xTaskCreatePinnedToCore(spamRandomSSIDSlow, "spamRandomSSIDSlow", 4096, NULL, 2, &wifiTaskHandle, 1);
            } else if (menu_items[current_menu] == "Random (Fast)") {
                xTaskCreatePinnedToCore(spamRandomSSIDFast, "spamRandomSSIDFast", 4096, NULL, 2, &wifiTaskHandle, 1);
            } else if (menu_items[current_menu] == "Custom SSID") {
                xTaskCreatePinnedToCore(spamCustomSSID, "spamCustomSSID", 4096, NULL, 2, &wifiTaskHandle, 1);
            } else if (menu_items[current_menu] == "About") {
                display.clearDisplay();
                display.setTextSize(1);
                display.setTextColor(SSD1306_WHITE);
                display.setCursor(20, 20);
                display.println(F("Developer: UN4"));
                display.setCursor(20, 30);
                display.println(F("HW: ESP32"));
                display.setCursor(20, 40);
                display.println(F("v0.1"));
                display.display();
                vTaskDelay(3000 / portTICK_PERIOD_MS);
                menu_active = true;
            }
            lastDebounceTime = millis();
        }
    } else {
        if (digitalRead(BTN_DOWN) == HIGH && digitalRead(BTN_UP) == HIGH && (millis() - lastDebounceTime) > debounceDelay) {
            spamming = false;
            WiFi.softAPdisconnect(true);
            if (wifiTaskHandle != NULL) {
                vTaskDelete(wifiTaskHandle);
                wifiTaskHandle = NULL;
            }
            menu_active = true;
            lastDebounceTime = millis();
        }
    }
}